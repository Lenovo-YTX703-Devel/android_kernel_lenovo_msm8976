/* Copyright (c) 2015, The Linux Foundation. All rights reserved.
 *
 * This program is free software; you can redistribute it and/or modify
 * it under the terms of the GNU General Public License version 2 and
 * only version 2 as published by the Free Software Foundation.
 *
 * This program is distributed in the hope that it will be useful,
 * but WITHOUT ANY WARRANTY; without even the implied warranty of
 * MERCHANTABILITY or FITNESS FOR A PARTICULAR PURPOSE.  See the
 * GNU General Public License for more details.
 */

&mdss_mdp {
	dsi_dual_nt35597_video: qcom,mdss_dsi_nt35597_wqxga_video {
		qcom,mdss-dsi-panel-name = "nt35597 video mode dual dsi panel without DSC";
		qcom,mdss-dsi-panel-type = "dsi_video_mode";
		qcom,mdss-dsi-panel-framerate = <60>;
		qcom,mdss-dsi-virtual-channel-id = <0>;
		qcom,mdss-dsi-stream = <0>;
		qcom,mdss-dsi-panel-width = <800>;
		qcom,mdss-dsi-panel-height = <2560>;
		//qcom,mdss-dsi-h-front-porch = <104>;    //460
		//qcom,mdss-dsi-h-back-porch = <72>;   //460
		qcom,mdss-dsi-h-front-porch = <17>;   //399
		qcom,mdss-dsi-h-back-porch = <30>;    //399
		qcom,mdss-dsi-h-pulse-width = <4>;
		qcom,mdss-dsi-h-sync-skew = <0>;
		qcom,mdss-dsi-v-back-porch = <24>;
		qcom,mdss-dsi-v-front-porch = <16>;
		qcom,mdss-dsi-v-pulse-width = <8>;
		qcom,mdss-dsi-bpp = <24>;
		qcom,mdss-dsi-underflow-color = <0xff>;
		qcom,mdss-dsi-border-color = <0>;
		qcom,mdss-dsi-on-command = [39 01 00 00 01 00 06 f0 55 aa 52 08 00
			15 01 00 00 01 00 02 c0 0d
			39 01 00 00 01 00 05 b8 03 06 00 00
			39 01 00 00 01 00 05 ff aa 55 a5 80
			15 01 00 00 01 00 02 6f 0f
			15 01 00 00 01 00 02 f7 01
			39 01 00 00 01 00 05 ff aa 55 a5 00
			15 01 00 00 01 00 02 62 01
			15 01 00 00 01 00 02 55 00
			15 01 00 00 01 00 02 53 24
			15 01 00 00 01 00 02 51 80
			05 01 00 00 78 00 02 11 00
			05 01 00 00 15 00 02 29 00];
		qcom,mdss-dsi-off-command = [05 01 00 00 78 00 02 28 00
				 05 01 00 00 78 00 02 10 00];
		qcom,mdss-dsi-on-command-state = "dsi_lp_mode";
		qcom,mdss-dsi-off-command-state = "dsi_hs_mode";
		qcom,mdss-dsi-h-sync-pulse = <0>;
		qcom,mdss-dsi-traffic-mode = "non_burst_sync_event";
		qcom,mdss-dsi-bllp-eof-power-mode;
		qcom,mdss-dsi-bllp-power-mode;
		qcom,mdss-dsi-lane-0-state;
		qcom,mdss-dsi-lane-1-state;
		qcom,mdss-dsi-lane-2-state;
		qcom,mdss-dsi-lane-3-state;
		qcom,cmd-sync-wait-broadcast;
		//qcom,mdss-dsi-panel-timings = [f3 3a 26 00 6a 6e 2c 3e 2f 03 04 00];
		qcom,mdss-dsi-panel-timings = [D5 32 22 00 60 64 26 34 29 03 04 00];	//MIPICLL 399
		qcom,mdss-dsi-t-clk-post = <0x02>;
		qcom,mdss-dsi-t-clk-pre = <0x2a>;
		qcom,mdss-dsi-dma-trigger = "trigger_sw";
		qcom,mdss-dsi-mdp-trigger = "none";
		qcom,mdss-dsi-reset-sequence = <1 20>, <0 20>, <1 50>;
	};
};
